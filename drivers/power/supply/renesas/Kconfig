## drivers/power/supply/renesas/Kconfig
```kconfig
# SPDX-License-Identifier: GPL-2.0
menu "Renesas Electronics Corporation Charger support"

config IDT_P9220
	tristate "IDT P9220 wireless charger"
	depends on I2C
	help
	  Enable support for the IDT P9220 wireless charging receiver.
	  The driver controls the receiver over I2C and reports charging
	  status through the power-supply framework.

endmenu
```

## techpack/audio/asoc/codecs/cs35l41/Kconfig
```kconfig
# SPDX-License-Identifier: GPL-2.0
config SND_SOC_CS35L41
	tristate "Cirrus Logic CS35L41 smart amplifier"
	depends on I2C && OF && FW_LOADER && REGULATOR && GPIOLIB && MFD
	select REGMAP_I2C
	select MFD_SPK_ID
	select SND_SOC_COMPRESS
	select SND_SOC_WM_ADSP
	help
	  Enable support for the Cirrus Logic CS35L41 smart amplifier
	  used by Xiaomi Cepheus.
```
